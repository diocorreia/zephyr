## drivers/counter/Kconfig.nxp_pcf85263a
```kconfig
#
# Copyright (c) 2022 Fraunhofer AICOS
#

config COUNTER_NXP_PCF85263A
	bool "NXP PCF85263A RTC/Stop-watch"
	depends on I2C
	help
	  Enable counter driver based on NXP PCF85263A I2C device.
```

## dts/bindings/rtc/nxp, pcf85263a.yaml
```yaml
#
# Copyright (c) 2022 Fraunhofer AICOS
#

description: NXP PCF85263A I2C RTC and Stop-watch

compatible: "nxp,pcf85263a"

include: i2c-device.yaml

properties:
  inta-gpios:
    type: phandle-array

  inta-mode:
    type: string
    enum:
      - "clock"
      - "battery"
      - "interrupt"
      - "high-z"

  ts-gpios:
    type: phandle-array

  ts-mode:
    type: string
    enum:
      - "disabled"
      - "interrupt"
      - "clock"
      - "input"
```
